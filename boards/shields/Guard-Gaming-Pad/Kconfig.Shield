## boards/shields/Guard-Gaming-Pad/Kconfig.defconfig
```kconfig
if SHIELD_GUARD_GAMING_PAD

config ZMK_KEYBOARD_NAME
    default "Guard_Gaming_Pad"

    end if
```

## boards/shields/Guard_Gaming_Pad/Kconfig.shield
```kconfig
config SHIELD_GUARD_GAMING_PAD
    def_bool $(shields_list_contains,Guard_Gaming_Pad)
```

## config/boards/shields/Guard-Gaming-Pad/Kconfig.Shield
```kconfig
config SHIELD_GUARDGAMINGPAD
    def_bool $(shields_list_contains, Guard-Gaming-Pad)
```

## config/boards/shields/Guard-Gaming-Pad/Kconfig.defconfig
```kconfig
if SHIELD_GUARDGAMINGPAD

config ZMK_KEYBOARD_NAME
    default "Guard-Gaming-Pad"

    end if
```
